## CMakeLists.txt
```
cmake_minimum_required(VERSION 3.20.0)

find_package(Zephyr REQUIRED HINTS $ENV{ZEPHYR_BASE})

project(outdoor_navigation_device LANGUAGES C)

target_sources(app PRIVATE
    src/main.c
    src/navigation.c
)
```

## prj.conf
```kconfig
CONFIG_CONSOLE=y
CONFIG_SERIAL=y
CONFIG_UART_CONSOLE=y
CONFIG_PRINTK=y
```

## src/main.c
```c
#include <zephyr/kernel.h>
#include <zephyr/sys/printk.h>

#include "navigation.h"

struct heading_test {
    float current;
    float target;
    float expected;
};

static const struct heading_test tests[] = {
    {350.0f,  10.0f,   20.0f},  /* Right across north */
    { 10.0f, 350.0f,  -20.0f},  /* Left across north */
    { 90.0f,  90.0f,    0.0f},  /* Already aligned */
    {  0.0f,  90.0f,   90.0f},  /* Ordinary right turn */
    { 90.0f,   0.0f,  -90.0f},  /* Ordinary left turn */
    {  0.0f, 180.0f,  180.0f},  /* Opposite: choose right */
    {180.0f,   0.0f,  180.0f},  /* Same rule in reverse */
    {  0.0f, 359.0f,   -1.0f},  /* Just below north */
    {359.0f,   0.0f,    1.0f},
    { 10.0f,  10.5f,    0.5f},  /* Fractional angle */
};

int main(void)
{
    const size_t test_count = sizeof(tests) / sizeof(tests[0]);
    size_t passed = 0;

    /* Give the serial monitor time to connect after reset. */
    k_msleep(1000);

    navigation_run_validation_tests();

    struct nav_position origin = {
        .latitude_deg = 0.0,
        .longitude_deg = 0.0
    };
    double metres = -1.0;

    bool ok = navigation_distance_m(origin, origin, &metres);
    printk("Same position: %s\n", (ok && metres == 0.0) ? "PASS" : "FAIL");

    const struct nav_position east = {
        .latitude_deg = 0.0,
        .longitude_deg = 1.0
    };
    metres = -1.0;

    ok = navigation_distance_m(origin, east, &metres);
    printk("One degree east: %s\n",
           (ok && metres >= 111194.0 && metres <= 111196.0)
               ? "PASS" : "FAIL");

    struct nav_position invalid_destination = {
        .latitude_deg = 91.0,
        .longitude_deg = 0.0
    };
    metres = -1.0;

    ok = navigation_distance_m(origin, invalid_destination, &metres);
    printk("Invalid destination latitude: %s\n",
           (!ok && metres == -1.0) ? "PASS" : "FAIL");

    double bearing_deg = -1.0;
    bool bearing_ok = navigation_initial_bearing_deg(origin, east, &bearing_deg);

    printk("Bearing east: %s\n",
           (bearing_ok && bearing_deg >= 89.999 && bearing_deg <= 90.001)
               ? "PASS" : "FAIL");

    const struct nav_position west = {
        .latitude_deg = 0.0,
        .longitude_deg = -1.0
    };
    bearing_deg = -1.0;
    bearing_ok = navigation_initial_bearing_deg(origin, west, &bearing_deg);

    printk("Bearing west: %s\n",
           (bearing_ok && bearing_deg >= 269.999 && bearing_deg <= 270.001)
               ? "PASS" : "FAIL");

    bearing_deg = -1.0;
    bearing_ok = navigation_initial_bearing_deg(origin, origin, &bearing_deg);

    printk("Bearing same position: %s\n",
           (!bearing_ok && bearing_deg == -1.0) ? "PASS" : "FAIL");

    struct nav_guidance guidance;

    bool guidance_ok = navigation_calculate_guidance(
        origin, east, 60.0f, &guidance);

    bool guidance_passed =
        guidance_ok &&
        guidance.distance_m >= 111194.0 &&
        guidance.distance_m <= 111196.0 &&
        guidance.target_bearing_deg >= 89.999 &&
        guidance.target_bearing_deg <= 90.001 &&
        guidance.heading_error_deg >= 29.999f &&
        guidance.heading_error_deg <= 30.001f;

    printk("Combined guidance right turn: %s\n",
           guidance_passed ? "PASS" : "FAIL");

        guidance_ok = navigation_calculate_guidance(
        origin, east, 120.0f, &guidance);

    printk("Combined guidance left turn: %s\n",
           (guidance_ok &&
            guidance.heading_error_deg >= -30.001f &&
            guidance.heading_error_deg <= -29.999f)
               ? "PASS" : "FAIL");

    guidance_ok = navigation_calculate_guidance(
        origin, east, 90.0f, &guidance);

    printk("Combined guidance aligned: %s\n",
           (guidance_ok &&
            guidance.heading_error_deg >= -0.001f &&
            guidance.heading_error_deg <= 0.001f)
               ? "PASS" : "FAIL");
               
    printk("\nNavigation heading tests\n");

    for (size_t i = 0; i < test_count; ++i) {
        float actual = navigation_heading_error(
            tests[i].current, tests[i].target);

        float difference = actual - tests[i].expected;

        /* Compare with a tolerance rather than exact float equality. */
        int matches = (difference >= -0.001f &&
                       difference <=  0.001f);

        if (matches) {
            ++passed;
        }

        /*
         * Print millidegrees as integers to avoid needing floating-point
         * formatting support in printk. 1000 millidegrees = 1 degree.
         */
        printk("Test %u: %s | expected %d, got %d millidegrees\n",
               (unsigned int)(i + 1),
               matches ? "PASS" : "FAIL",
               (int)(tests[i].expected * 1000.0f),
               (int)(actual * 1000.0f));
    }

    printk("Result: %u/%u passed\n",
           (unsigned int)passed,
           (unsigned int)test_count);

    return 0;
}
```

## src/navigation.c
```c
#include "navigation.h"
#include <math.h>
#include <zephyr/sys/printk.h>
#include <stddef.h>

static bool position_is_valid(struct nav_position position)
{
    /* Reject non-finite coordinates and values outside valid ranges. */
    return isfinite(position.latitude_deg) && isfinite(position.longitude_deg) && 
           position.latitude_deg >= -90.0 && position.latitude_deg <= 90.0 && 
           position.longitude_deg >= -180.0 && position.longitude_deg <= 180.0;
}

void navigation_run_validation_tests(void)
{
    struct nav_position position = {
        .latitude_deg = 0.0,
        .longitude_deg = 0.0
    };

    bool actual = position_is_valid(position);

    printk("Valid origin: %s\n", actual ? "PASS" : "FAIL");

    position.latitude_deg = 91.0;
    actual = position_is_valid(position);

    printk("Invalid latitude: %s\n", !actual ? "PASS" : "FAIL");

    position.latitude_deg = 0.0;
    position.longitude_deg = 181.0;
    actual = position_is_valid(position);

    printk("Invalid longitude: %s\n", !actual ? "PASS" : "FAIL");
}

float navigation_heading_error(float current_heading_deg,
                               float target_bearing_deg)
{
    float error_deg = target_bearing_deg - current_heading_deg;

    if (error_deg > 180.0f) {
        error_deg -= 360.0f;
    } else if (error_deg <= -180.0f) {
        error_deg += 360.0f;
    }

    return error_deg;
}

const double deg_to_rad = 3.14159265358979323846 / 180.0;

bool navigation_distance_m(struct nav_position current, struct nav_position destination, double *distance_m)
{
    if (!position_is_valid(current) || !position_is_valid(destination) || distance_m == NULL) {
        return false;
    }

    /* Calculate the distance using the Haversine formula. */
    double delta_lat_rad = (destination.latitude_deg - current.latitude_deg) * deg_to_rad;
    double delta_lon_rad = (destination.longitude_deg - current.longitude_deg) * deg_to_rad;
    double radius_earth_m = 6371000.0; /* Average radius of Earth in meters */

    double distance_a;
    double distance_c;
    
    distance_a = sin(delta_lat_rad / 2) * sin(delta_lat_rad / 2) +
                        cos(current.latitude_deg * deg_to_rad) *
                        cos(destination.latitude_deg * deg_to_rad) *
                        sin(delta_lon_rad / 2) * sin(delta_lon_rad / 2);

    if (distance_a < 0.0){
        distance_a = 0.0;
    } else if (distance_a > 1.0){
        distance_a = 1.0;
    }

    distance_c = 2 * atan2(sqrt(distance_a), sqrt(1 -distance_a));
    *distance_m = radius_earth_m * distance_c;  

    return true;
}

bool navigation_initial_bearing_deg(struct nav_position current,struct nav_position destination, double *bearing_deg)
{
    if (!position_is_valid(current) || !position_is_valid(destination) || bearing_deg == NULL) {
        return false;
    }

    if (current.latitude_deg == destination.latitude_deg &&
        current.longitude_deg == destination.longitude_deg) {
        return false;
    } 
    
    double current_lat_rad = current.latitude_deg * deg_to_rad;
    double destination_lat_rad = destination.latitude_deg * deg_to_rad;
    double delta_lon_rad = (destination.longitude_deg - current.longitude_deg) * deg_to_rad;

    double east_component = sin(delta_lon_rad) * cos(destination_lat_rad);
    double north_component = cos(current_lat_rad) * sin(destination_lat_rad) -
                             sin(current_lat_rad) * cos(destination_lat_rad) * cos(delta_lon_rad);

    *bearing_deg = atan2(east_component, north_component) / deg_to_rad;

    if (*bearing_deg < 0.0) {
        *bearing_deg += 360.0;
    }
    if (*bearing_deg >= 360.0) {
        *bearing_deg -= 360.0;
    }

    return true;
}

bool navigation_calculate_guidance(struct nav_position current,
                                   struct nav_position destination,
                                   float current_heading_deg,
                                   struct nav_guidance *guidance)
{
    /* Reject a NULL output pointer or an invalid heading. */
    if (guidance == NULL || !isfinite(current_heading_deg) ||
        current_heading_deg < 0.0f || current_heading_deg >= 360.0f) {
        return false;
    }
    /* Calculate into a local result before updating the caller. */
    struct nav_guidance result;
    if (!navigation_distance_m(current, destination, &result.distance_m)){
        return false;
    }

    if (!navigation_initial_bearing_deg(current, destination, &result.target_bearing_deg)){
        return false;
    }

    result.heading_error_deg = navigation_heading_error(current_heading_deg, (float)result.target_bearing_deg);
    *guidance = result;
    return true;
}
```

## src/navigation.h
```c
#ifndef NAVIGATION_H
#define NAVIGATION_H
#include <stdbool.h>

/*
 * Calculate the shortest turn from current heading to target bearing.
 *
 * Inputs must be finite angles in [0, 360) degrees.
 * Positive result: turn right.
 * Negative result: turn left.
 * Zero: aligned.
 * Exactly opposite: consistently choose right (+180 degrees).
 */
float navigation_heading_error(float current_heading_deg,
                               float target_bearing_deg);

struct nav_position {
    double latitude_deg; /* Decimal Degrees: [-90, 90] */
    double longitude_deg; /* Decimal Degrees: [-180, 180] */
};

struct nav_guidance {
    double distance_m;
    double target_bearing_deg;
    float heading_error_deg;
};

/*
 * Calculate distance in metres between two geographic positions.
 *
 * Returns true on success and writes the distance to *distance_m.
 * Returns false for invalid coordinates or a NULL output pointer.
 * On failure, the output is left unchanged.
 */
bool navigation_distance_m(struct nav_position current,
                           struct nav_position destination,
                           double *distance_m);

bool navigation_initial_bearing_deg(struct nav_position current,
                               struct nav_position destination,
                               double *bearing_deg);

/*
 * Calculate guidance using a heading measured from true north.
 *
 * current_heading_deg must be finite and in [0, 360).
 * Returns true and writes *guidance on success.
 * Returns false and leaves *guidance unchanged on failure.
 */
bool navigation_calculate_guidance(struct nav_position current,
                                   struct nav_position destination,
                                   float current_heading_deg,
                                   struct nav_guidance *guidance);

/* Temporary test entry point. */
void navigation_run_validation_tests(void);

#endif
```
